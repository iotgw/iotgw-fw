## sdkconfig.defaults
```kconfig
# Serial flash
CONFIG_ESPTOOLPY_PORT="/dev/tty.SLAB_USBtoUART"
CONFIG_ESPTOOLPY_BAUD_OTHER=y
CONFIG_ESPTOOLPY_BAUD_OTHER_VAL=1497600
CONFIG_ESPTOOLPY_COMPRESSED=y
CONFIG_ESPTOOLPY_FLASHSIZE_4MB=y

CONFIG_PARTITION_TABLE_CUSTOM=y
CONFIG_PARTITION_TABLE_CUSTOM_FILENAME="partitions.csv"
CONFIG_ENABLE_PERIPH_BLUFI=y
CONFIG_ENABLE_PERIPH_WEB=y
CONFIG_BT_ENABLED=y
CONFIG_ENABLE_PERIPH_WEB=y
#CONFIG_TIMER_TASK_STACK_DEPTH=4096
#CONFIG_TIMER_TASK_STACK_SIZE=5120
CONFIG_BTDM_CONTROLLER_BLE_MAX_CONN=1
#CONFIG_NEWLIB_NANO_FORMAT=y
CONFIG_ESP32_WIFI_TASK_PINNED_TO_CORE_0=y
CONFIG_ESP32_WIFI_TASK_PINNED_TO_CORE_1=
CONFIG_LWIP_MAX_SOCKETS=10
CONFIG_HEAP_TRACING=n
```
